## configs/sbc030_defconfig
```kconfig
BR2_m68k=y
BR2_m68k_68030=y
BR2_OPTIMIZE_2=y
BR2_KERNEL_HEADERS_4_20=y
BR2_TOOLCHAIN_BUILDROOT_WCHAR=y
BR2_GCC_VERSION_5_X=y
BR2_ROOTFS_DEVICE_CREATION_DYNAMIC_MDEV=y
# BR2_TARGET_GENERIC_GETTY is not set
BR2_SYSTEM_DHCP="eth0"
BR2_ROOTFS_OVERLAY="board/sbc030/rootfs-overlay"
BR2_ROOTFS_POST_BUILD_SCRIPT="board/sbc030/post_build.sh"
BR2_LINUX_KERNEL=y
BR2_LINUX_KERNEL_CUSTOM_GIT=y
BR2_LINUX_KERNEL_CUSTOM_REPO_URL="https://github.com/piotrekk94/sbc030-linux.git"
BR2_LINUX_KERNEL_CUSTOM_REPO_VERSION="sbc030-port"
BR2_LINUX_KERNEL_DEFCONFIG="sbc030"
BR2_LINUX_KERNEL_LZO=y
BR2_LINUX_KERNEL_INSTALL_TARGET=y
BR2_PACKAGE_BUSYBOX_CONFIG="board/sbc030/busybox-config"
BR2_PACKAGE_C64KBD=y
# BR2_PACKAGE_IFUPDOWN_SCRIPTS is not set
BR2_TARGET_UBOOT=y
BR2_TARGET_UBOOT_BOARDNAME="SBC030"
BR2_TARGET_UBOOT_CUSTOM_GIT=y
BR2_TARGET_UBOOT_CUSTOM_REPO_URL="https://github.com/piotrekk94/sbc030-u-boot.git"
BR2_TARGET_UBOOT_CUSTOM_REPO_VERSION="sbc030-port"
BR2_PACKAGE_HOST_UBOOT_TOOLS=y
```

## package/c64kbd/Config.in
```kconfig
config BR2_PACKAGE_C64KBD
	bool "c64kbd"
	help
	  C64 UART keyboard event handler
```

## package/ninvaders/Config.in
```kconfig
config BR2_PACKAGE_NINVADERS
	bool "ninvaders"
	select BR2_PACKAGE_NCURSES
	help
	  Jhead is a program for manipulating settings and thumbnails
	  in Exif jpeg headers used by most Digital Cameras.

	  http://www.sentex.net/~mwandel/jhead/
```
